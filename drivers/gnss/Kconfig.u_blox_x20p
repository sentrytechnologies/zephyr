## drivers/gnss/Kconfig.u_blox_x20p
```kconfig
# Copyright (c) 2025 Sentry Technologies
# SPDX-License-Identifier: Apache-2.0

config GNSS_U_BLOX_X20P
	bool "U-BLOX X20P High precision GNSS Module"
	default y
	depends on GNSS
	depends on DT_HAS_U_BLOX_X20P_ENABLED
	select MODEM_MODULES
	select MODEM_BACKEND_UART
	select MODEM_UBX
	help
	  Enable U-BLOX X20P High precision GNSS modem driver.

if GNSS_U_BLOX_X20P

choice GNSS_U_BLOX_X20P_NAV_MODE_HIGH_DYN
	prompt "High Dynamics mode setting"
	default GNSS_U_BLOX_X20P_NAV_MODE_HIGH_DYN_AIRBORNE_2G
	help
	  Choose what the High Dynamics Navigation mode should be for your
	  application use-case.

config GNSS_U_BLOX_X20P_NAV_MODE_HIGH_DYN_AIRBORNE_1G
	bool "Consider High Dynamics mode as 1G Airborne"

config GNSS_U_BLOX_X20P_NAV_MODE_HIGH_DYN_AIRBORNE_2G
	bool "Consider High Dynamics mode as 2G Airborne"

config GNSS_U_BLOX_X20P_NAV_MODE_HIGH_DYN_AIRBORNE_4G
	bool "Consider High Dynamics mode as 4G Airborne"

config GNSS_U_BLOX_X20P_NAV_MODE_HIGH_DYN_AUTOMOTIVE
	bool "Consider High Dynamics mode as Automotive mode"

config GNSS_U_BLOX_X20P_NAV_MODE_HIGH_DYN_SEA
	bool "Consider High Dynamics mode as Sea mode"

config GNSS_U_BLOX_X20P_NAV_MODE_HIGH_DYN_BIKE
	bool "Consider High Dynamics mode as Bike mode"

endchoice

if GNSS_SATELLITES

config GNSS_U_BLOX_X20P_SATELLITES_COUNT
	int "Maximum satellite count"
	default 24

endif # GNSS_SATELLITES

if GNSS_RTK

config GNSS_U_BLOX_X20P_RTK
	bool "Use RTK to improve fix accuracy"
	default y
	depends on GNSS_RTK_PROTOCOL_RTCM3

if GNSS_U_BLOX_X20P_RTK

config GNSS_U_BLOX_X20P_STATION
	bool "Use station mode support on X20P module"
	default n

endif # GNSS_U_BLOX_X20P_RTK

endif # GNSS_RTK

endif # GNSS_U_BLOX_X20P
```

## drivers/sensor/murata/Kconfig
```kconfig
# Copyright (c) 2025 Sentry Technologies ApS
# SPDX-License-Identifier: Apache-2.0

# zephyr-keep-sorted-start
source "drivers/sensor/murata/sch16t/Kconfig"
# zephyr-keep-sorted-stop
```

## drivers/sensor/murata/sch16t/Kconfig
```kconfig
# Copyright (c) 2025 Sentry Technologies ApS
# SPDX-License-Identifier: Apache-2.0

config SCH16T
	bool "SCH16T Combined Gyro Sensor and Accelerometer"
	default y
	depends on DT_HAS_MURATA_SCH16T_ENABLED
	select SPI
	select SPI_RTIO
	select SENSOR_ASYNC_API
	help
	  Enable driver for SCH16T Combined Gyro Sensor and Accelerometer
```

## drivers/sensor/witmotion/Kconfig
```kconfig
# Copyright (c) 2025 Sentry Technologies
# SPDX-License-Identifier: Apache-2.0

config WITMOTION
	bool "WIT Motion Sensors"
	default n
	help
	  Enable driver support for WIT Motion sensors.

# zephyr-keep-sorted-start
source "drivers/sensor/witmotion/hwt905ttl/Kconfig"
# zephyr-keep-sorted-stop
```

## drivers/sensor/witmotion/hwt905ttl/Kconfig
```kconfig
# Copyright (c) 2025 Sentry Technologies
# SPDX-License-Identifier: Apache-2.0

config HWT905TTL
    bool "WIT Motion HWT905-TTL IMU"
    default n
    depends on WITMOTION
    depends on DT_HAS_WITMOTION_HWT905TTL_ENABLED
    depends on UART_INTERRUPT_DRIVEN
    help
      Enable driver for WIT Motion HWT905-TTL IMU.

if HWT905TTL

config HWT905TTL_TRIGGER
    bool "Enable trigger (global workqueue)"

endif # HWT905TTL
```

## dts/bindings/gnss/u-blox,f9p.yaml
```yaml
# Copyright (c) 2025 Croxel Inc.
# Copyright (c) 2025 CogniPilot Foundation
# Copyright (c) 2025 Sentry Technologies
# SPDX-License-Identifier: Apache-2.0

description: U-BLOX F9P High Precision GNSS Module

compatible: "u-blox,f9p"

include:
  - uart-device.yaml

properties:
  fix-rate:
    type: int
    default: 1000
    description: |
      Initial fix-rate GNSS modem will be operating on. May be adjusted at
      run-time through GNSS APIs. Must be greater than 50-ms.
      Default is power-on setting.

  rtk-mode:
    type: string
    enum:
      - "none"
      - "station"
      - "rover"
    default: "none"
    description: |
      Describe the RTK mode that this device should be configured as. Setting this to `rover`
      requires that CONFIG_GNSS_U_BLOX_F9P_RTK is enabled.
```

## dts/bindings/gnss/u-blox,x20p.yaml
```yaml
# Copyright (c) 2025 Sentry Technologies
# SPDX-License-Identifier: Apache-2.0

description: U-BLOX X20P High Precision GNSS Module

compatible: "u-blox,x20p"

include:
  - uart-device.yaml

properties:
  fix-rate:
    type: int
    default: 1000
    description: |
      Initial fix-rate GNSS modem will be operating on. May be adjusted at
      run-time through GNSS APIs. Must be greater than 50-ms.
      Default is power-on setting.

  reset:
    type: boolean
    description: |
      Force reset of the X20P module on initialization. This can be useful to clear cached settings
      and locked sattellites.

  rtk-mode:
    type: string
    enum:
      - "none"
      - "station"
      - "rover"
    default: "none"
    description: |
      Describe the RTK mode that this device should be configured as. Default value is the cold-boot
      default within the module itself.

  svin-acc-lim:
    type: int
    default: 5000
    description: |
      When in station mode, a survey in is performed. For that, it is necessary to know the minimum
      necessary accuracy limit (in mm). Default value is the one that u-center defaults to.

  svin-min-dur:
    type: int
    default: 60
    description: |
      When in station mode, a survey in is performed. For that, it is necessary to know the minimum
      required duration for the survey (in s). Default value is the one that u-center defaults to.
```

## dts/bindings/sensor/murata,sch16t.yaml
```yaml
# Copyright (c) 2025 Sentry Technologies ApS
# SPDX-License-Identifier: Apache-2.0

description: SCH16T combined gyro sensor and accelerometer

compatible: "murata,sch16t"

include: [sensor-device.yaml, spi-device.yaml]

properties:
  decimation:
    type: int
    default: 0
    description: |
      Decimation indicates the reduction factor of the output sample rate. The total reduction
      factor will be 2^n, where n is the value provided here.

  acc-dynamic-range:
    type: int
    default: 1
    description: |
      Dynamic range for accelerometer. This controls the measurement range. The map of values is the
      following:
        1 | ±80 m/s²
        2 | ±60 m/s²
        3 | ±30 m/s²
        4 | ±15 m/s²

  rate-dynamic-range:
    type: int
    default: 1
    description: |
      Dynamic range for gyroscope. This controls the measurement range. The map of values is the
      following:
        1 | ±300 deg/s
        2 | ±300 deg/s
        3 | ±125 deg/s
        4 | ±62.5 deg/s

  reset-gpios:
    type: phandle-array
    required: true
    description: |
      EXTRESN GPIO acting as a reset.

  int-gpios:
    type: phandle-array
    description: |
      DRY_SYNC GPIO for interrupt handling for streaming mode.
```

## dts/bindings/sensor/witmotion,hwt905ttl.yaml
```yaml
# Copyright (c) 2025 Sentry Technologies
# SPDX-License-Identifier: Apache-2.0

description: WIT Motion HWT905-TTL IMU

compatible: "witmotion,hwt905ttl"

include: [sensor-device.yaml, uart-device.yaml]
```
