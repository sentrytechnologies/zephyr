## drivers/gnss/Kconfig.u_blox
```kconfig
# Copyright (c) 2025 Croxel Inc.
# Copyright (c) 2025 CogniPilot Foundation
# Copyright (c) 2025 Sentry Technologies
# SPDX-License-Identifier: Apache-2.0

config GNSS_U_BLOX
	bool "U-BLOX GNSS Module"
	default y
	depends on GNSS
	depends on DT_HAS_U_BLOX_F9P_ENABLED || DT_HAS_U_BLOX_X20P_ENABLED
	select MODEM_MODULES
	select MODEM_BACKEND_UART
	select MODEM_UBX
	help
	  Enable U-BLOX GNSS modem driver.
	  Supports ZED-F9P and ZED-X20P modules.

if GNSS_U_BLOX

choice GNSS_U_BLOX_NAV_MODE_HIGH_DYN
	prompt "High Dynamics mode setting"
	default GNSS_U_BLOX_NAV_MODE_HIGH_DYN_AIRBORNE_2G
	help
	  Choose what the High Dynamics Navigation mode should be for your
	  application use-case.

config GNSS_U_BLOX_NAV_MODE_HIGH_DYN_AIRBORNE_1G
	bool "Consider High Dynamics mode as 1G Airborne"

config GNSS_U_BLOX_NAV_MODE_HIGH_DYN_AIRBORNE_2G
	bool "Consider High Dynamics mode as 2G Airborne"

config GNSS_U_BLOX_NAV_MODE_HIGH_DYN_AIRBORNE_4G
	bool "Consider High Dynamics mode as 4G Airborne"

config GNSS_U_BLOX_NAV_MODE_HIGH_DYN_AUTOMOTIVE
	bool "Consider High Dynamics mode as Automotive mode"

config GNSS_U_BLOX_NAV_MODE_HIGH_DYN_SEA
	bool "Consider High Dynamics mode as Sea mode"

config GNSS_U_BLOX_NAV_MODE_HIGH_DYN_BIKE
	bool "Consider High Dynamics mode as Bike mode"

endchoice

if GNSS_SATELLITES

config GNSS_U_BLOX_SATELLITES_COUNT
	int "Maximum satellite count"
	default 24

endif # GNSS_SATELLITES

if GNSS_RTK

config GNSS_U_BLOX_RTK
	bool "Use RTK to improve fix accuracy"
	default y
	depends on GNSS_RTK_PROTOCOL_RTCM3

if GNSS_U_BLOX_RTK

config GNSS_U_BLOX_STATION
	bool "Use station mode support"
	default n

endif # GNSS_U_BLOX_RTK

endif # GNSS_RTK

endif # GNSS_U_BLOX
```
